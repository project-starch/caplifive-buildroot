## Config.in
```kconfig
source "$BR2_EXTERNAL_CAPSTONE_PATH/package/modcapstone/Config.in"
source "$BR2_EXTERNAL_CAPSTONE_PATH/package/capstone-test-domains/Config.in"
source "$BR2_EXTERNAL_CAPSTONE_PATH/package/capstone-sbi-domain/Config.in"
```

## configs/fpga_defconfig
```kconfig
# Architecture
BR2_riscv=y
BR2_RISCV_64=y

# System
BR2_TARGET_GENERIC_GETTY=y


# Linux headers same as kernel
BR2_PACKAGE_HOST_LINUX_HEADERS_CUSTOM_6_1=y

# Kernel
BR2_LINUX_KERNEL=y
BR2_LINUX_KERNEL_CUSTOM_VERSION=y
BR2_LINUX_KERNEL_CUSTOM_VERSION_VALUE="6.1.26"
BR2_LINUX_KERNEL_IMAGE=y
BR2_LINUX_KERNEL_USE_CUSTOM_CONFIG=y
BR2_LINUX_KERNEL_CUSTOM_CONFIG_FILE="$(BR2_EXTERNAL_CAPSTONE_PATH)/configs/fpgakernel.config"
BR2_LINUX_KERNEL_DTS_SUPPORT=y
BR2_LINUX_KERNEL_CUSTOM_DTS_PATH="$(BR2_EXTERNAL_CAPSTONE_PATH)/configs/caplifive.dts"

# Bootloader
BR2_TARGET_OPENSBI=y
# BR2_TARGET_OPENSBI_PAYLOAD_IMAGE=y
# BR2_TARGET_OPENSBI_LINUX_PAYLOAD=y
# BR2_TARGET_OPENSBI_LINUX_PAYLOAD_PATH="../build/images/Image"
BR2_TARGET_OPENSBI_CUSTOM_VERSION=y
BR2_TARGET_OPENSBI_CUSTOM_VERSION_VALUE="1.2"
BR2_TARGET_OPENSBI_PLAT="fpga/ariane"



# Capstone external
BR2_PACKAGE_MODCAPSTONE=y
BR2_PACKAGE_CAPSTONE_TEST_DOMAINS=y
BR2_PACKAGE_CAPSTONE_SBI_DOMAIN=y
BR2_PACKAGE_CAPSTONE_NULL_BLK=y
BR2_PACKAGE_CAPSTONE_NESTED_ENCLAVE=y

BR2_TARGET_ROOTFS_CPIO=y
BR2_ROOTFS_OVERLAY="$(BR2_EXTERNAL_CAPSTONE_PATH)/overlay"
BR2_TARGET_ROOTFS_CPIO_GZIP=y
BR2_TARGET_ROOTFS_INITRAMFS=y
```

## package/capstone-dpdk-multip/Config.in
```kconfig
config BR2_PACKAGE_CAPSTONE_DPDK_MULTIP
    bool "capstone_dpdk_multip"
    select BR2_TOOLCHAIN_HEADERS_AT_LEAST_6_1
    help
        DPDK multi-process sample application case study.
```

## package/capstone-nested-enclave/Config.in
```kconfig
config BR2_PACKAGE_CAPSTONE_NESTED_ENCLAVE
    bool "capstone_nested_enclave"
    select BR2_TOOLCHAIN_HEADERS_AT_LEAST_6_1
    help
        Web server in nested domains case study.
```

## package/capstone-null-blk/Config.in
```kconfig
config BR2_PACKAGE_CAPSTONE_NULL_BLK
    bool "capstone_null_blk"
    select BR2_TOOLCHAIN_HEADERS_AT_LEAST_6_1
    help
        Null block driver with Captainer support.

        https://capstone.kisp-lab.org/
```

## package/capstone-rust/Config.in
```kconfig
config BR2_PACKAGE_CAPSTONE_RUST
    bool "capstone-rust"
    help

        https://capstone.kisp-lab.org/
```

## package/capstone-sbi-domain/Config.in
```kconfig
config BR2_PACKAGE_CAPSTONE_SBI_DOMAIN
    bool "capstone-sbi-domain"
    help
        Captainer domain that includes an SBI-providing C mode.
```

## package/capstone-test-domains/Config.in
```kconfig
config BR2_PACKAGE_CAPSTONE_TEST_DOMAINS
    bool "capstone-test-domains"
    help
        Test domains.
```

## package/capstone-test/Config.in
```kconfig
config BR2_PACKAGE_CAPSTONE_TEST
    bool "capstonetest"
    help
        Test program for Capstone.

        https://capstone.kisp-lab.org/
```

## package/modcapstone/Config.in
```kconfig
config BR2_PACKAGE_MODCAPSTONE
    bool "modcapstone"
    help
        Kernel module for Capstone.
```
